## tasks/yocto/custom_layers/meta-myautolayer/conf/layer.conf
```bitbake
# We have a conf and classes directory, add to BBPATH
BBPATH .= ":${LAYERDIR}"

# We have recipes-* directories, add to BBFILES
BBFILES += "${LAYERDIR}/recipes-*/*/*.bb \
            ${LAYERDIR}/recipes-*/*/*.bbappend"

BBFILE_COLLECTIONS += "meta-myautolayer"
BBFILE_PATTERN_meta-myautolayer = "^${LAYERDIR}/"
BBFILE_PRIORITY_meta-myautolayer = "6"

LAYERDEPENDS_meta-myautolayer = "core"
LAYERSERIES_COMPAT_meta-myautolayer = "honister"
```

## tasks/yocto/custom_layers/meta-mymanlayer/conf/layer.conf
```bitbake
# We have a conf and classes directory, add to BBPATH
BBPATH .= ":${LAYERDIR}"

# We have recipes-* directories, add to BBFILES
BBFILES += "${LAYERDIR}/recipes-*/*/*.bb \
            ${LAYERDIR}/recipes-*/*/*.bbappend"

BBFILE_COLLECTIONS += "meta-mymanlayer"
BBFILE_PATTERN_meta-mymanlayer = "^${LAYERDIR}/"
BBFILE_PRIORITY_meta-mymanlayer = "6"

LAYERDEPENDS_meta-mymanlayer = "core"
LAYERSERIES_COMPAT_meta-mymanlayer = "honister"
```
